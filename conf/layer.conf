## conf/layer.conf
```bitbake
# We have a conf and classes directory, append to BBPATH
BBPATH .= ":${LAYERDIR}"

# We have recipes-* directories, add to BBFILES
BBFILES += "${LAYERDIR}/recipes-*/*/*.bb ${LAYERDIR}/recipes-*/*/*.bbappend"

BBFILE_COLLECTIONS += "ublox-tk1"
BBFILE_PATTERN_ublox-tk1 = "^${LAYERDIR}/"
BBFILE_PRIORITY_ublox-tk1 = "90"

LAYERDEPENDS_ublox-tk1 = " \
    core \
    openembedded-layer multimedia-layer networking-layer \
    angstrom-layer \
    browser-layer \
    lxde-layer \
"
```
